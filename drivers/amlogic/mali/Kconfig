## drivers/amlogic/mali/Kconfig
```kconfig
menu "Mali GPU OpenGL device driver"

config MALI
	tristate "Mali support"
	depends on m
	default m
	select FB
	---help---
	  This enables support for the Mali-300, Mali-400, and Mali-450 GPUs.

config MALI_DEBUG
	bool "Enable debug in Mali driver"
	depends on MALI
	---help---
	  This enabled extra debug checks and messages in the Mali-300/400/450
	  driver.

config MALI_PROFILING
	bool "Enable Mali profiling"
	depends on MALI && TRACEPOINTS
	---help---
	  This enables gator profiling of Mali GPU events.

config MALI_GPU_UTILIZATION
	bool "Enable Mali GPU utilization tracking"
	depends on MALI
	---help---
	  This enables gathering and processing of the utilization of Mali GPU.
	  This data can be used as a basis to change GPU operating frequency.
	  
endmenu
```
